## br_package/python-numpy/Config.in
```kconfig
config BR2_PACKAGE_PYTHON_NUMPY
    bool "python-numpy"
    depends on BR2_PACKAGE_PYTHON3   # 注意是 depends on，不是 select
    help
      NumPy is the fundamental package for scientific computing with Python.
```

## sysdrv/source/buildroot/buildroot-2024.11.4/package/python-apprise/Config.in
```kconfig
config BR2_PACKAGE_PYTHON_APPRISE
	bool "python-apprise"
	select BR2_PACKAGE_PYTHON_CERTIFI
	select BR2_PACKAGE_PYTHON_REQUESTS
	select BR2_PACKAGE_PYTHON_REQUESTS_OAUTHLIB
	select BR2_PACKAGE_PYTHON_CLICK
	select BR2_PACKAGE_PYTHON_MARKDOWN
	select BR2_PACKAGE_PYTHON_PYAML
	help
	  Apprise allows you to send notifications to almost all of
	  the most popular notification services available to us today.
	  https://pypi.org/project/apprise/
```

## sysdrv/source/buildroot/buildroot-2024.11.4/package/python-numpy/Config.in
```kconfig
config BR2_PACKAGE_PYTHON_NUMPY_ARCH_SUPPORTS
	bool
	# Numpy has some CPU specific code
	default y if BR2_arc
	default y if BR2_aarch64
	default y if BR2_arm
	default y if BR2_armeb
	default y if BR2_i386
	default y if BR2_mips
	default y if BR2_mipsel
	default y if BR2_powerpc
	default y if BR2_powerpc64
	default y if BR2_riscv
	default y if BR2_sh
	default y if BR2_x86_64

config BR2_PACKAGE_PYTHON_NUMPY
	bool "python-numpy"
	depends on BR2_PACKAGE_PYTHON_NUMPY_ARCH_SUPPORTS
	depends on BR2_INSTALL_LIBSTDCPP
	depends on BR2_TOOLCHAIN_GCC_AT_LEAST_8
	help
	  NumPy is the fundamental package for scientific computing
	  with Python.

	  Note that NumPy needs fenv.h fully supported by the
	  C library.

	  http://www.numpy.org/

comment "python-numpy needs a toolchain w/ C++, gcc >= 8"
	depends on BR2_PACKAGE_PYTHON_NUMPY_ARCH_SUPPORTS
	depends on !BR2_INSTALL_LIBSTDCPP || !BR2_TOOLCHAIN_GCC_AT_LEAST_8
```

## sysdrv/source/buildroot/buildroot-2024.11.4/package/python-streaming-form-data/Config.in
```kconfig
config BR2_PACKAGE_PYTHON_STREAMING_FORM_DATA
bool "python-streaming-form-data"
depends on BR2_PACKAGE_PYTHON3
help
  Streaming parser for multipart/form-data.
  Required by Moonraker 3D printer API server.

  https://github.com/siddhantgoel/streaming-form-data
```
